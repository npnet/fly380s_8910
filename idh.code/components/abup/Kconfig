## idh.code/components/abup/Kconfig
```kconfig
# Copyright (C) 2018 RDA Technologies Limited and/or its affiliates("RDA").
# All rights reserved.
#
# This software is supplied "AS IS" without any warranties.
# RDA assumes no responsibility or liability for the use of the software,
# conveys no license or title under any patent, copyright, or mask work
# right to the product. RDA reserves the right to make changes in the
# software without notification.  RDA also make no representation or
# warranty that such application will be suitable for the specified use
# without further testing or modification.

menu "ABUP"

config ABUP_SUPPORT
    bool "abup supported"
    default y if SOC_8910
    default n
    help
        When enabled, at least one ABUP engine should be supported.

if ABUP_SUPPORT
config ABUP_DUMMY_SUPPORT
    bool "Enable dummy ABUP engine"
    default y
    help
        Dummy ABUP engine is not a real ABUP engine. It will synthesis text
        into some tones. It is just to demonstrate how to integrate ABUP
        engine.

        When real ABUP engine is used, it must be disabled.
endif

endmenu
```

## idh.code/components/ats/bt/Kconfig
```kconfig
# Copyright (C) 2018 RDA Technologies Limited and/or its affiliates("RDA").
# All rights reserved.
#
# This software is supplied "AS IS" without any warranties.
# RDA assumes no responsibility or liability for the use of the software,
# conveys no license or title under any patent, copyright, or mask work
# right to the product. RDA reserves the right to make changes in the
# software without notification.  RDA also make no representation or
# warranty that such application will be suitable for the specified use
# without further testing or modification.

menu "at_bt"

config AT_SPBTTEST_SUPPORT
    bool "AT_SPBTTEST_SUPPORT enabled"
    default n
    help
        When enabled, CONFIG_AT_SPBTTEST_SUPPORT will be defined

config AT_SPBLETEST_SUPPORT
    bool "AT_SPBLETEST_SUPPORT enabled"
    default n
    help
        When enabled, CONFIG_AT_SPBLETEST_SUPPORT will be defined

config AT_SPBLE_SUPPORT
    bool "AT_SPBLE_SUPPORT enabled"
    default n
    select BLUEU_BT_ENABLE
    help
        When enabled, CONFIG_AT_SPBLE_SUPPORT will be defined

config AT_BT_CLASSIC_SUPPORT
    bool "AT_BT_CLASSIC_SUPPORT enabled"
    default n
    select BLUEU_BT_ENABLE
    help
        When enabled, CONFIG_AT_BT_CLASSIC_SUPPORT will be defined

config AT_BTCOMM_SUPPORT
    bool "AT_BTCOMM_SUPPORT enabled"
    default n
    select BLUEU_BT_ENABLE
    help
        When enabled, CONFIG_AT_BTCOMM_SUPPORT will be defined

endmenu
```

## idh.code/components/ats/ftp/Kconfig
```kconfig
# Copyright (C) 2018 RDA Technologies Limited and/or its affiliates("RDA").
# All rights reserved.
#
# This software is supplied "AS IS" without any warranties.
# RDA assumes no responsibility or liability for the use of the software,
# conveys no license or title under any patent, copyright, or mask work
# right to the product. RDA reserves the right to make changes in the
# software without notification.  RDA also make no representation or
# warranty that such application will be suitable for the specified use
# without further testing or modification.

menu "at_ftp"

choice
	prompt "select ftp version"
	default AT_NEWFTP_SUPPORT
config AT_FTP_SUPPORT
	bool "Enable the old version ftp client command"
	help
		Enable the old version ftp client command
config AT_NEWFTP_SUPPORT
	bool "Enable the new version ftp client command"
	select FTP_MODULE_SUPPORT
	help
		Enable the new version ftp client command
config AT_NOFTP_SUPPORT
	bool "Disable the at ftp clinet command"
	help
		Disable the at ftp client command

endchoice
endmenu
```

## idh.code/components/bootloader/Kconfig
```kconfig
# Copyright (C) 2018 RDA Technologies Limited and/or its affiliates("RDA").
# All rights reserved.
#
# This software is supplied "AS IS" without any warranties.
# RDA assumes no responsibility or liability for the use of the software,
# conveys no license or title under any patent, copyright, or mask work
# right to the product. RDA reserves the right to make changes in the
# software without notification.  RDA also make no representation or
# warranty that such application will be suitable for the specified use
# without further testing or modification.

menu "bootloader"

if SOC_8910
    config FDL1_IMAGE_START
        hex "FDL1 uimage SRAM start"
        default 0x810000 if SOC_8910
        help
            FDL1 uimage SRAM start (not the code start address).

    config FDL1_IMAGE_SIZE
        hex "FDL1 uimage SRAM size"
        default 0x8000 if SOC_8910
        help
            FDL1 uimage size (including uimage header).

    config FDL2_IMAGE_START
        hex "FDL2 uimage SRAM start"
        default 0x818000 if SOC_8910
        help
            FDL2 uimage SRAM start (not the code start address).

    config FDL2_IMAGE_SIZE
        hex "FDL2 uimage SRAM size"
        default 0x10000 if SOC_8910
        help
            FDL2 uimage size (including uimage header).

    config BOOT_TTB_START
        hex "boot TTB start"
        default 0x828000
        help
            Location of TTB memory. It will be used when MMU is enabled.
            To make life easier, it is reserved even MMU is not enabled.

            Don't change it unless you know what you are doing.

    config BOOT_TTB_SIZE
        hex "boot TTB size"
        default 0x4400
        help
            Don't change it unless you know what you are doing.

    config BOOT_EXCEPTION_STACK_START
        hex "boot exception stack start"
        default 0x82c400
        help
            Location of stack for all exception modes.

            Don't change it unless you know what you are doing.

    config BOOT_SVC_STACK_SIZE
        hex "boot SVC stack size"
        default 0xa00
        help
            Stack size of supervisor mode.

            Don't change it unless you know what you are doing.

    config BOOT_IRQ_STACK_SIZE
        hex "boot IRQ stack size"
        default 0x200
        help
            Stack size of IRQ mode.

            Don't change it unless you know what you are doing.

    config BOOT_SRAM_HEAP_START
        hex "boot SRAM heap start"
        default 0x82d000

    config BOOT_SRAM_HEAP_SIZE
        hex "boot SRAM_heap size"
        default 0x13000
endif

config BOOT_TIMER_IRQ_ENABLE
    bool "enable timer IRQ"
    default n
    help
        When enabled, interrupt will be enabled in bootloader, and timer
        IRQ will be enabled. It is only used to feed external watchdog.

if BOOT_TIMER_IRQ_ENABLE
    config BOOT_TIMER_PERIOD
    int "boot timer period (ms)"
    default 500
    help
        Bootloader timer period, in milliseconds.
endif

config NVBIN_FIXED_SIZE
    hex "NV bin fixed size"
    default 0x20000 if SOC_8910
    help
        At nv backup, fixed size is needed for nv bin read and write.
        This size should be large enough to hold all fixed nv bin.

config FDL_UART_BAUD
    int "Baud rate of default FDL UART"
    default 921600 if SOC_8910
    default 921600 if SOC_8811
    default 115200 if SOC_6760

choice
    prompt "FDL default UART"
    default FDL_DEFAULT_UART2

    config FDL_DEFAULT_UART1
        bool "UART1"

    config FDL_DEFAULT_UART2
        bool "UART2"

    config FDL_DEFAULT_UART3
        bool "UART3"
endchoice

config FDL_DEFAULT_UART
    string
    default "DRV_NAME_UART1" if FDL_DEFAULT_UART1
    default "DRV_NAME_UART2" if FDL_DEFAULT_UART2
    default "DRV_NAME_UART3" if FDL_DEFAULT_UART3
    default ""

endmenu
```

## idh.code/components/diag/Kconfig
```kconfig
# Copyright (C) 2018 RDA Technologies Limited and/or its affiliates("RDA").
# All rights reserved.
#
# This software is supplied "AS IS" without any warranties.
# RDA assumes no responsibility or liability for the use of the software,
# conveys no license or title under any patent, copyright, or mask work
# right to the product. RDA reserves the right to make changes in the
# software without notification.  RDA also make no representation or
# warranty that such application will be suitable for the specified use
# without further testing or modification.

menu "Diag"

config DIAG_ENABLED
    bool "Enable diag"
    default y if SOC_8910
    default n

if DIAG_ENABLED
config DIAG_DATA_BUFF_SIZE
    int "Data mode buffer size"
    default 4096
    help
        Buffer size for data mode. In PPP mode, it should be enough to hold the
        packet before HDLC decoding. At buffer overflow, the content of the buffer
        will be dropped silently.

config DIAG_DEVICE_USRL_SUPPORT
    bool "usb diag device support"
    default y if SOC_8910
    default n

if DIAG_DEVICE_USRL_SUPPORT
choice
    prompt "Default Userial"
    default DIAG_DEFAULT_USRL_COM1

config DIAG_DEFAULT_USRL_COM0
    bool "USRL0"

config DIAG_DEFAULT_USRL_COM1
    bool "USRL1"

config DIAG_DEFAULT_USRL_COM2
    bool "USRL2"

config DIAG_DEFAULT_USRL_COM3
    bool "USRL3"

endchoice

config DIAG_DEFAULT_USERIAL
    string
    default "DRV_NAME_USRL_COM0" if DIAG_DEFAULT_USRL_COM0
    default "DRV_NAME_USRL_COM1" if DIAG_DEFAULT_USRL_COM1
    default "DRV_NAME_USRL_COM2" if DIAG_DEFAULT_USRL_COM2
    default "DRV_NAME_USRL_COM3" if DIAG_DEFAULT_USRL_COM3
    default ""
endif

choice
    prompt "Default UART"
    default DIAG_DEFAULT_UART2 if SOC_8910

config DIAG_DEFAULT_UART1
    bool "UART1"

config DIAG_DEFAULT_UART2
    bool "UART2"

config DIAG_DEFAULT_UART3
    bool "UART3"

endchoice

config DIAG_DEFAULT_UART
    string
    default "DRV_NAME_UART1" if DIAG_DEFAULT_UART1
    default "DRV_NAME_UART2" if DIAG_DEFAULT_UART2
    default "DRV_NAME_UART3" if DIAG_DEFAULT_UART3
    default ""

config DIAG_DEFAULT_UART_BAUD
    int "Baud rate of default UART"
    default 921600 if SOC_8910
    default 921600 if SOC_6760

endif
endmenu
```

## idh.code/components/driver/Kconfig
```kconfig
# Copyright (C) 2018 RDA Technologies Limited and/or its affiliates("RDA").
# All rights reserved.
#
# This software is supplied "AS IS" without any warranties.
# RDA assumes no responsibility or liability for the use of the software,
# conveys no license or title under any patent, copyright, or mask work
# right to the product. RDA reserves the right to make changes in the
# software without notification.  RDA also make no representation or
# warranty that such application will be suitable for the specified use
# without further testing or modification.

menu "Driver configuration"

config DEBUGHOST_RX_USE_IFC
    bool "Debughost rx use IFC"
    default n
    help
        When debughost RX uses IFC, one additional IFC channel will be
        occupied. Though it is possible there is data lose without IFC,
        it is recommended not to use IFC.

if DEBUGHOST_RX_USE_IFC
config DEBUGHOST_RX_DMA_SIZE
    hex "Debughost rx DMA size"
    default 0x200
    help
        Debughost RX DMA size. The size mus be multiple of D-cache
        line size.
endif

config DEBUGHOST_RX_BUF_SIZE
    hex "Debughost rx buffer size"
    default 0x200
    help
        Debughost RX buffer size.

config HOST_CMD_ENGINE_MAX_PACKET_SIZE
    hex "Host command engine packet size"
    default 0x2020
    help
        The maximum packet size of host command engine.

config UART_BLUESCREEN_ENABLE
    bool "Enable UART daemon on blue screen"
    default y
    help
        At panic, start the daemon on UART. Usually, the UART will be the same
        as AT UART, due to AT can't work at blue screen. Also, the UART will
        work at fixed higher baud rate.

if UART_BLUESCREEN_ENABLE
choice
    prompt "UART used in blue screen"
    default UART_BLUESCREEN_UART2 if SOC_8955 || SOC_8909
    default UART_BLUESCREEN_UART1
    help
        UART to be used in blue screen mode. It is suggested to reuse AT UART,
        though it is not necessary.

    config UART_BLUESCREEN_UART1
        bool "UART1"

    config UART_BLUESCREEN_UART2
        bool "UART2"

    config UART_BLUESCREEN_UART3
        bool "UART3"
endchoice

config UART_BLUESCREEN
    string
    default "DRV_NAME_UART1" if UART_BLUESCREEN_UART1
    default "DRV_NAME_UART2" if UART_BLUESCREEN_UART2
    default "DRV_NAME_UART3" if UART_BLUESCREEN_UART3
    default ""

config UART_BLUESCREEN_BAUD
    int "Baud rate of bluescreen UART"
    default 921600
    help
        It is suggested to set a higher baud rate in blue screen mode.

        To reduce complexity in blue screen mode, only limited baud rates are
        supported.
endif

config UART_AUTOMODE_DEFAULT_BAUD
    int "Default baud rate of adaptive mode"
    default 115200 if SOC_8910
    default 921600 if SOC_6760
    default 115200 if SOC_8955
    default 57600 if SOC_8909
    default 115200 if SOC_8811
    help
        It is suggested to set a baud rate when UART in adaptive baud rate mode.
        UART Tx can send data througt the baud rate.


config SUPPORT_BATTERY_CHARGER
    bool "support battery charge"
    default y
    help
        enable charger.

config SUPPORT_EXT_FLASH
    bool "support extra flash"
    default n
    help
        When enable, it will config clock about FLASH1 to support extra flash.

config USB_SUPPORT
    bool "support usb"
    default y if SOC_8910
    default n

if USB_SUPPORT
config USB_CONNECT_TIMEOUT
    int "usb connect timeout"
    default 10000
    help
        After charger on interrupt triggered, we should enable the usb controller,
        if there is not a usb host but a pure charger, we should close the controller
        to save power.
        The software judge there is a pure charger or usb host by set address command,
        if more than this <USB_CONNECT_TIMEOUT> milliseconds did not receive set address,
        the software close the usb controller.

config USB_DETECT_DEBOUNCE_TIME
    int "usb debounce time in milliseconds before eumerating"
    default 800
    help
        Debuouce a little milliseconds before start enumerating.
endif

config LCD_SUPPORT
    bool "support lcd"
    default y if SOC_8910
    default n
    help
        Whether LCD is supported.

if LCD_SUPPORT
config SUPPORT_LCD_GC9305
    bool "support GC9305 panel"
    default y
    help
        Support GC9305 LCD panel

config SUPPORT_LCD_ST7735S
    bool "support ST7735S panel"
    default y
    help
        Support ST7735S LCD panel

endif
endmenu
```
