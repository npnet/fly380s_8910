## idh.code/components/net/Kconfig
```kconfig
# Copyright (C) 2018 RDA Technologies Limited and/or its affiliates("RDA").
# All rights reserved.
#
# This software is supplied "AS IS" without any warranties.
# RDA assumes no responsibility or liability for the use of the software,
# conveys no license or title under any patent, copyright, or mask work
# right to the product. RDA reserves the right to make changes in the
# software without notification.  RDA also make no representation or
# warranty that such application will be suitable for the specified use
# without further testing or modification.

menu "net"

config NET_LWIP_DEBUG
    bool "enable lwip debug"
    default y
    help
        when enabled, LWIP_DEBUG will be defined to 1.

config NET_TCPIP_SUPPORT
    bool "tcpip enabled"
    default y
    help
        When enabled, CONFIG_NET_TCPIP_SUPPORT will be defined

config NET_LOG_BUF_COUNT
    int "Log buffer count"
    default 2

config NET_LOG_BUF_SIZE
    int "Log buffer size"
    default 8192

config NET_LWIP_IPV4_ON
    bool "Ipv4 enabled"
    default y
    help
        When enabled, CONFIG_NET_LWIP_IPV4_ON will be defined

config NET_LWIP_PPP_ON
    bool "ppp enabled"
    default y
    help
        When enabled, CONFIG_NET_LWIP_PPP_ON will be defined

config NET_TRACE_IP_PACKET
    bool "trace IP packet identify"
    default y if SOC_8910
    default n
    help
        When enabled, identify of IP packet will be show in trace.

        It is just for debug, and usually not needed in produciton.

config NET_ALI_SDK_SUPPORT
    bool "NET_ALI_SDK_SUPPORT enabled"
    default y
    help
        When enabled, NET_ALI_SDK_SUPPORT will be defined

config NET_ALI_SDK_DYNAMIC_LOAD
    bool "NET_ALI_SDK_DYNAMIC_LOAD enabled"
    default n
    help
        When enabled, NET_ALI_SDK_DYNAMIC_LOAD will be defined
orsource "mupnp/Kconfig"
orsource "http/Kconfig"

endmenu
```

## idh.code/components/poc/Kconfig
```kconfig
# Copyright (C) 2018 RDA Technologies Limited and/or its affiliates("RDA").
# All rights reserved.
#
# This software is supplied "AS IS" without any warranties.
# RDA assumes no responsibility or liability for the use of the software,
# conveys no license or title under any patent, copyright, or mask work
# right to the product. RDA reserves the right to make changes in the
# software without notification.  RDA also make no representation or
# warranty that such application will be suitable for the specified use
# without further testing or modification.

menu "POC"

config POC_SUPPORT
    bool "POC supported"
    default y
    help
        When enabled, poc should be supported.

if POC_SUPPORT
config POC_AUDIO_RECORDER_SUPPORT
    bool "POC audio recorder supported"
    default y
    help
        poc audio recorder should be supported.

config POC_AUDIO_PLAYER_SUPPORT
    bool "POC audio player supported"
    default y
    help
        poc audio player should be supported.

config POC_AUDIO_PLAYER_PIPE_SUPPORT
	bool "POC audio player pipe supported"
	default y
	help
		poc audio player pipe should be supported.

config POC_KEYPAD_SUPPORT
    bool "POC keypad supported"
    default y
    help
        poc keypad should be supported.

config POC_GUI_SUPPORT
    bool "POC gui supported"
    default y
    help
        poc gui should be supported.

config POC_GUI_CHOICE_SIM_SUPPORT
    bool "POC gui choice sim card supported"
    default n
    help
        poc gui should be supported.

config POC_GUI_START_ANIMATION_SUPPORT
    bool "POC gui start animation supported"
    default y
    help
        poc gui should be supported.

config POC_GUI_CHOICE_SIM_SUPPORT
    bool "POC gui choice sim card supported"
    default n
    help
        poc gui should be supported.

config POC_TTS_SUPPORT
    bool "POC TTS supported"
    default n
    help
        poc gui should be supported.

config POC_GUI_CHOICE_NET_TYPE_SUPPORT
    bool "POC gui choice net type supported"
    default n
    help
        poc gui should be supported.

config POC_GUI_CHOICE_THEME_SUPPORT
    bool "POC gui choice theme supported"
    default n
    help
        poc gui should be supported.

config POC_AUDIO_SPEAKER_WOMEN
    bool "POC gui choice SPEAKER supported"
    default y
    help
        poc gui should be supported.

config POC_GUI_KEYPAD_LIGHT_SUPPORT
    bool "POC gui keypad light supported"
    default n
    help
        poc gui should be supported.

config POC_GUI_TOUCH_SUPPORT
	bool "POC gui touch supported"
    default y
    help
        poc gui should be supported.

config POC_GUI_GPS_SUPPORT
    bool "POC gui gps supported"
    default y
    help
        poc gui should be supported.

config POC_FOTA_SUPPORT
    bool "POC fota supported"
    default y
    help
        poc gui should be supported.

config POC_POWER_ON_FOTA_SUPPORT
    bool "POC power on fota supported"
    default n
    help
        poc gui should not be supported.
		
config POC_AUDIO_DATA_IDT_BUFF_MAX_SIZE
    int "receive idt data by buff"
    default 3
    help
        open status more than 3 , close status less than 4
		
config POC_PING_NETWORK_SUPPORT
    bool "POC ping supported"
    default n
    help
        poc gui should not be supported.
		
config POC_CIT_KEY_SUPPORT
    bool "POC cit key supported"
    default y
    help
        poc gui should be supported.

config POC_GUI_FLASH_SUPPORT
	bool "POC gui flash supported"
    default y
    help
        poc gui should be supported.

config POC_GUI_LCD_VOL_2_3_SUPPORT
    bool "POC lcd 2.3V supported"
    default n
    help
        poc gui should not be supported.
endif

endmenu
```
